## im-magic.its
```
/dts-v1/;

/ {
        description = "U-Boot fitImage for OpenBMC";
        #address-cells = <1>;

        images {
                kernel@1 {
                        description = "Linux kernel";
                        data = /incbin/("zImage");
                        type = "kernel";
                        arch = "arm";
                        os = "linux";
                        compression = "none";
                        load = <0x40100000>;
                        entry = <0x40100000>;
                        hash@1 {
                                algo = "sha512";
                        };
                };
                fdt@gxp.dtb {
                        description = "Flattened Device Tree blob";
                        data = /incbin/("gxp.dtb");
                        type = "flat_dt";
                        arch = "arm";
                        compression = "none";
                        hash@1 {
                                algo = "sha512";
                        };
                };
                ramdisk@1 {
                        description = "obmc-phosphor-initramfs";
                        data = /incbin/("initramfs.cpio.lzma");
                        type = "ramdisk";
                        arch = "arm";
                        os = "linux";
                        compression = "none";

                        hash@1 {
                                algo = "sha512";
                        };
                };

        };

        configurations {
                default = "conf@gxp.dtb";
                conf@gxp.dtb {
                        description = "Linux kernel, FDT blob";
                        kernel = "kernel@1";
                        fdt = "fdt@gxp.dtb";
                        ramdisk = "ramdisk@1";

                        hash@1 {
                                algo = "sha512";
                        };
                };
        };
};
```
